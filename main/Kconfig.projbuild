## main/Kconfig.projbuild
```kconfig
menu "OTA WiFi Configuration"

config STATION_SSID
    string "Station SSID"
	default "fengboming"
	help
		SSID (network name) for the example to connect to.

config STATION_PASSPHRASE
    string "Station Passphrase"
	default "bomingfeng1"
	help
		WiFi password (WPA or WPA2) for the example to use.

		Can be left blank if the network has no security set.

config AP_SSID
    string "AP SSID"
	default "ESP32-C3 OTA"
	help
		AP SSID (network name) for the ESP32 to act as a AP

config AP_PASSPHARSE
    string "AP Passphrase"
	default "12345678"
	help
		AP password (WPA or WPA2) to use.

		Can be left blank if the network has no security set.

config SPIFFS_BASE_ADDR
    hex "SPIFFS Base address"
    range 0x100000 0x1FFE000
    default 0x180000
    help
	Starting address of the SPIFFS area in ESP32 Flash
	Write the address in hex format, 0x180000

config SPIFFS_SIZE
    int "SPIFFS Size in bytes"
    range 262144 2097152
    default 1048576

config SPIFFS_LOG_BLOCK_SIZE
    int "SPIFFS Logical block size"
    range 4098 65536
    default 8192

config SPIFFS_LOG_PAGE_SIZE
    int "SPIFFS Logical page size"
    range 256 2048
    default 256
    help
		Set it to the phisycal page size og the used SPI Flash chip.
			
endmenu
```
